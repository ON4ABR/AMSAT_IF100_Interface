/* ON4ABR - 11-2023 V.1.0
   Easycomm-2 to AMSAT IF-100 interface
   Designed for Arduino Nano but will probably works on any Arduino variant
   Accepts EASYCOM-II format tracking command via the serial port (9600Bd)
   - Set position format AZnn.n ELnn.n <LF>
   - Query position AZ EL <LF> (Simulated value as the IF100 provide no return information!)
   Can be used with Hamlib's ROTCTLD mode 202
*/

//FLOAT!
#define azMax 360.0              //Maximum rotation angle of azimuth motor 360 degrees
#define elMax 180.0              //Maximum rotation angle of elevation motor 180 degrees
#define pinData 2                //Pin with data for IF100 - Connect to DB25 pin 2
#define pinClock 3               //Pin to clock out data to IF100 - Connect to DB25 pin3
#define pinTrack 5               //Pin to activate tracking

//#define DEBUG                  //Uncomment to get debuginfo i=on the serial port

//Globals
float azSet = 0.0;               //Antenna azimuth set point
float elSet = 0.0;               //Antenna elevation set point
String line;                     //Storage for incomming command

void setup() {
  //Initialize the serial port
  Serial.begin(9600);
#ifdef DEBUG
  Serial.println("PRGM Start");
#endif

  //Output pin's
  pinMode(pinData, OUTPUT);
  pinMode(pinClock, OUTPUT);
  pinMode(pinTrack, OUTPUT);

  //init pins
  digitalWrite(pinData, LOW);
  digitalWrite(pinClock, LOW);
  digitalWrite(pinTrack, HIGH);

  //Reset rotors
  IF100_Set_Position(0.0 , 0.0);
}

void loop() {
  processCommands();                                  //handle incomming requests
}

void IF100_Set_Position(float az, float el) {
  //Send data to IF100 controller
  int az_i;
  int el_i;
  int dataout, i;
  double az_scale = 255. / 360.0;                     //Calculate scale (8bits = max 255)
  double el_scale = 255. / 180.0;

  az_i = (int)round(az * az_scale);                   //Convert settings to integer values
  el_i = (int)round(el * el_scale);
  dataout = ((el_i & 0xff) << 8) + (az_i & 0xff);     //Store bin-values in 16-bit var
#ifdef DEBUG
  Serial.print("az_i: ");
  Serial.print(az_i);
  Serial.print("\tel_i: ");
  Serial.println(el_i);
  Serial.print("bin stream: ");
#endif

  for (i = 0; i < 16; i++)                            //Step through each bit
  {
    if (dataout & 0x8000)                             //Mask MSB
    {
#ifdef DEBUG
      Serial.print("1");
#endif
      //Write "1"
      digitalWrite(pinData, HIGH);                    //Set dataline High
    }
    else
    {
#ifdef DEBUG
      Serial.print("0");
#endif
      //Write "0"
      digitalWrite(pinData, LOW);                     //Set dataline Low
    }

    digitalWrite(pinClock, HIGH);                     //Generate clock pulse
    digitalWrite(pinClock, LOW);

    dataout = (dataout << 1) & 0xffff;                //Shift to next bit
  }
#ifdef DEBUG
  Serial.println();
#endif
}

void processEasycommCommands(String line) {
  //Process Easycomm II rotator commands
  //Easycomm II position command: AZnn.n ELnn.n \n
  //Easycomm II query command: AZ EL \n
  String param;                                           //Parameter value
  int firstSpace;                                         //Position of the first space in the command line
  int secondSpace;                                        //Position of the second space in the command line
  if (line.startsWith("AZ EL")) {                         //Query command received
    printAzEl();                                          //Send the current Azimuth and Elevation
  } else {
    if (line.startsWith("AZ")) {                          //Position command received: Parse the line.
      firstSpace = line.indexOf(' ');                     //Get the position of the first space
      secondSpace = line.indexOf(' ', firstSpace + 1);    //Get the position of the second space
      param = line.substring(2, firstSpace);              //Get the first parameter
      azSet = param.toFloat();                            //Set the azSet value
      azSet = constrain(azSet, 0, azMax);                 //Limit azimuth
      param = line.substring(firstSpace + 3, secondSpace);//Get the second parameter
      elSet = param.toFloat();                            //Set the elSet value
      elSet = constrain(elSet, 0, elMax);                 //Limit elevation
      IF100_Set_Position(azSet, elSet);                   //Send data to IF100 controller
#ifdef DEBUG
      Serial.print("azSet:");
      Serial.print(azSet);
      Serial.print("\telSet: ");
      Serial.println(elSet);
#endif
    }
  }
}

void processCommands(void) {
  //Process incoming data from the control computer
  //Easycomm commands are generated by a tracking program and are terminated with a line feed
  while (Serial.available() > 0) {
    char ch = Serial.read();                                //Read a single character from the serial buffer
    switch (ch) {
      case 10:                                              //Line feed received
#ifdef DEBUG
        Serial.print("Data received: ");
        Serial.println(line);
#endif
        processEasycommCommands(line);                      //Process Easycomm commands
        line = "";                                          //Command processed: Clear the command line
        break;
      default:                                              //Any other character received
        line += ch;                                         //Add this character to the command line
        break;
    }
  }
}

void printAzEl() {
  //Print the rotator feedback data in Easycomm II format
  Serial.print("AZ");
  Serial.print((azSet < 0) ? (azSet + 360) : azSet, 1);
  Serial.print(" EL");
  Serial.print(elSet, 1);
  Serial.print("\n");
}
